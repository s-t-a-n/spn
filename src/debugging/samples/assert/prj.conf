## CMakeLists.txt
```
cmake_minimum_required(VERSION 3.20.0)
get_filename_component(REPO_ROOT "${CMAKE_CURRENT_LIST_DIR}/../../../.." ABSOLUTE)
list(APPEND EXTRA_ZEPHYR_MODULES "${REPO_ROOT}")
find_package(Zephyr REQUIRED HINTS $ENV{ZEPHYR_BASE})

project(spn_debugging_assert_sample)

target_sources(app PRIVATE src/main.cpp)
target_link_libraries(app PRIVATE spn::debugging)
```

## prj.conf
```kconfig
# Enable fully-featured C++
CONFIG_CPP=y
CONFIG_REQUIRES_FULL_LIBCPP=y
CONFIG_STD_CPP20=y # C++20 ISO standard
CONFIG_CPP_EXCEPTIONS=n
CONFIG_CPP_RTTI=n
# Enable GNU-style static constructors
CONFIG_STATIC_INIT_GNU=y

# Enable SPN Debugging Library
CONFIG_SPN_DEBUGGING=y
CONFIG_SPN_ASSERT_LEVEL=2
CONFIG_SPN_ASSERT_HANDLER=y
```

## src/main.cpp
```c
#include "spn/debugging/assert.hpp"

#include <zephyr/kernel.h>
#include <zephyr/logging/log.h>

LOG_MODULE_REGISTER(spn_debugging_sample, LOG_LEVEL_INF);

static void custom_assert_handler(const char* file, int line, const char* condition, const char* message) {
    LOG_ERR("Custom Assert Handler: %s at %s:%d - %s", condition, file, line, message);
}

static void custom_expect_handler(const char* file, int line, const char* condition, const char* message) {
    LOG_WRN("Custom Expect Handler: %s at %s:%d - %s", condition, file, line, message);
}

int main(void) {
    LOG_INF("SPN Debugging Assert Sample");

    LOG_INF("Testing basic use of spn_assert/expect");
    spn_assert(true == true);
    spn_expect(true == true);

    LOG_INF("Registering custom handlers...");
    spn::debugging::set_spn_assert_handler(custom_assert_handler);
    spn::debugging::set_spn_expect_handler(custom_expect_handler);

    LOG_INF("Testing expectation failure with custom handler...");
    spn_expect(1 == 2);
    LOG_INF("Expectation failure handled by custom handler");

    LOG_INF("Resetting handlers...");
    spn::debugging::set_spn_assert_handler(nullptr);
    spn::debugging::set_spn_expect_handler(nullptr);

    LOG_INF("Testing expectation without handler...");
    spn_expect(false);
    LOG_INF("Expectation without handler completed");

    LOG_INF("Assert sample completed successfully");
    return 0;
}
```
