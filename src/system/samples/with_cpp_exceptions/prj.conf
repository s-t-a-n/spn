## CMakeLists.txt
```
cmake_minimum_required(VERSION 3.20.0)
get_filename_component(REPO_ROOT "${CMAKE_CURRENT_LIST_DIR}/../../../.." ABSOLUTE)
list(APPEND EXTRA_ZEPHYR_MODULES "${REPO_ROOT}")
find_package(Zephyr REQUIRED HINTS $ENV{ZEPHYR_BASE})

project(spn_system_with_cpp_exceptions)

target_sources(app PRIVATE src/main.cpp)
target_link_libraries(app PRIVATE
        spn::system
        spn::debugging
)
```

## sample.yaml
```
sample:
  name: system with cpp exceptions
tests:
  spn.system.sample.with_cpp_exceptions: {}
```

## prj.conf
```kconfig
# Enable fully-featured C++
CONFIG_CPP=y
CONFIG_REQUIRES_FULL_LIBCPP=y
CONFIG_STD_CPP20=y # C++20 ISO standard
CONFIG_CPP_RTTI=n
# Enable GNU-style static constructors
CONFIG_STATIC_INIT_GNU=y

# Enable SPN Libraries
CONFIG_SPN_LOGGING=y
CONFIG_SPN_SYSTEM=y
CONFIG_SPN_DEBUGGING=y
CONFIG_SPN_ASSERT_HANDLER=y

# Enable exceptions
CONFIG_CPP_EXCEPTIONS=y

# Enable logging
CONFIG_LOG=y
# CONFIG_LOG_MODE_DEFERRED=y
CONFIG_MAIN_STACK_SIZE=2048

# Enable system heap and runtime stats
CONFIG_SYS_HEAP_RUNTIME_STATS=y
CONFIG_HEAP_MEM_POOL_SIZE=8192

# Enable thread stack monitoring
CONFIG_THREAD_STACK_INFO=y
CONFIG_INIT_STACKS=y
```

## src/main.cpp
```c
#include "spn/debugging/assert.hpp"
#include "spn/logging/logging.hpp"
#include "spn/system/exception.hpp"

#include <zephyr/kernel.h>

LOG_MODULE_REGISTER(with_cpp_exceptions_sample);

int main(void) {
    LOG_INF("=== SPN System Sample (with C++ exceptions) ===");

    try {
        LOG_INF("creating and throwing runtime exception");
        spn::runtime_exception ex("sample runtime error");
        spn::throw_exception(ex);
    } catch (const spn::system::exception& e) {
        LOG_INF("caught exception: %s (%s)", e.what(), e.error_type());
    }

    try {
        LOG_INF("creating and throwing logic exception");
        spn::logic_exception ex("sample logic error");
        spn::throw_exception(ex);
    } catch (const spn::system::exception& e) {
        LOG_INF("caught exception: %s (%s)", e.what(), e.error_type());
    }

    LOG_INF("enabling exception-based assertions");
    spn::system::enable_assert_exceptions();

    LOG_INF("testing successful assertion");
    spn_assert(true);

    try {
        LOG_INF("testing assertion that will throw exception");
        spn_assert(false);
    } catch (const spn::assertion_exception& e) {
        LOG_INF("caught assertion exception: %s", e.what());
    }

    LOG_INF("=== Sample Complete ===");

    return 0;
}
```
