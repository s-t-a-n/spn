## src/system/tests/exception/testcase.yaml
```yaml
common:
  tags: spn system exception
  integration_platforms:
    - native_sim
tests:
  spn.system.exception.unit: { }
```

## src/system/tests/fatal_hook/testcase.yaml
```yaml
tests:
  system.fatal_hook:
    platform_allow: native_sim qemu_x86 qemu_cortex_m3
    tags: system fatal
    timeout: 60
```

## src/system/tests/integration/testcase.yaml
```yaml
tests:
  system.integration:
    platform_allow: native_sim qemu_x86 qemu_cortex_m3
    tags: system integration
    timeout: 60
```

## src/system/tests/shutdown/testcase.yaml
```yaml
common:
  tags: spn system shutdown
  integration_platforms:
    - native_sim
tests:
  spn.system.shutdown.unit: { }
```

## src/threading/Kconfig
```kconfig
config SPN_THREADING
    bool "Enable SPN threading primitives"
    select SPN_CONTAINERS
    select SPN_CORE
    select SPN_DEBUGGING
    select SPN_LOGGING
    select SPN_TIMING
    select ETL
    select EVENTS
    default n
    help
      Enable the SPN threading primitives library
```

## src/threading/tests/condition/testcase.yaml
```yaml
common:
  tags: spn threading_primitives condition
  integration_platforms:
    - native_sim
tests:
  spn.threading_primitives.condition.unit: { }
```

## src/threading/tests/mutex/testcase.yaml
```yaml
common:
  tags: spn threading_primitives mutex
  integration_platforms:
    - native_sim
tests:
  spn.threading_primitives.mutex.unit: { }
```

## src/threading/tests/refguard/testcase.yaml
```yaml
common:
  tags: spn threading refguard
  integration_platforms:
    - native_sim
tests:
  spn.threading_primitives.refguard.unit: { }
```

## src/threading/tests/semaphore/testcase.yaml
```yaml
common:
  tags: spn threading_primitives semaphore
  integration_platforms:
    - native_sim
tests:
  spn.threading_primitives.semaphore.unit: {}
```

## src/threading/tests/thread/testcase.yaml
```yaml
common:
  tags: spn threading thread
  integration_platforms:
    - native_sim
tests:
  spn.threading.thread.unit: {}
```

## src/threading/tests/work/testcase.yaml
```yaml
common:
  tags: spn threading work
  integration_platforms:
    - native_sim
tests:
  spn.threading.work.unit: {}
```

## src/timing/Kconfig
```kconfig
config SPN_TIMING
    bool "Enable SPN timing library"
    select SPN_CORE
    select ETL
    default n
    help
      Enable the SPN timing library for elapsed time measurement and timing utilities
```

## src/timing/tests/elapsed_timer/testcase.yaml
```yaml
common:
  tags: spn timing elapsed_timer
  integration_platforms:
    - native_sim
tests:
  spn.timing.elapsed_timer.unit: {}
```

## src/timing/tests/monotonic_clock/testcase.yaml
```yaml
common:
  tags: spn timing monotonic_clock
  integration_platforms:
    - native_sim
tests:
  spn.timing.monotonic_clock.unit: {}
```

## src/timing/tests/periodic_timers/testcase.yaml
```yaml
common:
  tags: spn timing periodic_timers
  integration_platforms:
    - native_sim
tests:
  spn.timing.periodic_timers.unit: {}
```

## src/timing/tests/rate_control/testcase.yaml
```yaml
common:
  tags: spn timing rate_control
  integration_platforms:
    - native_sim
tests:
  spn.timing.rate_control.unit: {}
```
