## CMakeLists.txt
```
cmake_minimum_required(VERSION 3.20.0)
get_filename_component(REPO_ROOT "${CMAKE_CURRENT_LIST_DIR}/../.." ABSOLUTE)
list(APPEND EXTRA_ZEPHYR_MODULES "${REPO_ROOT}")

# Set default board before finding Zephyr
set(BOARD native_sim)

find_package(Zephyr REQUIRED HINTS $ENV{ZEPHYR_BASE})

project(spn_develop_target)

target_sources(app PRIVATE src/main.cpp)
target_link_libraries(app PRIVATE
        spn::core
        spn::example_lib
        spn::logging
        spn::system
        spn::debugging
        spn::threading
        spn::timing
        spn::allocation
        spn::containers
        spn::dependency_injection
)
```

## prj.conf
```kconfig
# Enable fully-featured C++
CONFIG_CPP=y
CONFIG_REQUIRES_FULL_LIBCPP=y
CONFIG_STD_CPP20=y # C++20 ISO standard
CONFIG_CPP_EXCEPTIONS=n
CONFIG_CPP_RTTI=n
# Enable GNU-style static constructors
CONFIG_STATIC_INIT_GNU=y

# Enable all SPN modules
CONFIG_SPN_CORE=y
CONFIG_SPN_EXAMPLE_LIB=y
CONFIG_SPN_LOGGING=y
CONFIG_SPN_DEBUGGING=y
CONFIG_SPN_THREADING=y
CONFIG_SPN_TIMING=y
CONFIG_SPN_SYSTEM=y
CONFIG_SPN_ALLOCATION=y
CONFIG_SPN_CONTAINERS=y
CONFIG_SPN_DEPENDENCY_INJECTION=y

# Enable logging
CONFIG_LOG=y
CONFIG_LOG_MODE_DEFERRED=y
CONFIG_MAIN_STACK_SIZE=2048
```

## src/main.cpp
```c
#include <zephyr/kernel.h>

// allocation
#include "spn/allocation/heap.hpp"
#include "spn/allocation/pool.hpp"
#include "spn/allocation/shared_ptr.hpp"
#include "spn/allocation/slab.hpp"
#include "spn/allocation/types.hpp"
#include "spn/allocation/unique_ptr.hpp"

// containers
#include "spn/containers/callback.hpp"
#include "spn/containers/queue/mpmc_deque.hpp"
#include "spn/containers/queue/mpmc_queue.hpp"
#include "spn/containers/queue/mpsc_deque.hpp"
#include "spn/containers/queue/mpsc_queue.hpp"
#include "spn/containers/queue/spmc_deque.hpp"
#include "spn/containers/queue/spmc_queue.hpp"
#include "spn/containers/queue/spsc_queue.hpp"
#include "spn/containers/queue/spsc_queue_adapter.hpp"
#include "spn/containers/result.hpp"

// core
#include "spn/core/enum_flags.hpp"
#include "spn/core/tuple_utils.hpp"
#include "spn/core/type_traits.hpp"
#include "spn/core/types.hpp"

// debugging
#include "spn/debugging/assert.hpp"

// dependency_injection
#include "spn/dependency_injection/container.hpp"
#include "spn/dependency_injection/phases.hpp"
#include "spn/dependency_injection/providers.hpp"

// example_lib
#include "spn/example_lib/example_lib.hpp"

// logging
#include "spn/logging/logging.hpp"
#include "spn/logging/memory.hpp"

// system
#include "spn/system/exception.hpp"
#include "spn/system/shutdown.hpp"

// threading
#include "spn/threading/condition.hpp"
#include "spn/threading/event.hpp"
#include "spn/threading/lockguard.hpp"
#include "spn/threading/mutex.hpp"
#include "spn/threading/pacing/pacing_strategy.hpp"
#include "spn/threading/pacing/spin_pacing.hpp"
#include "spn/threading/pacing/throttle_pacing.hpp"
#include "spn/threading/pacing/timer_pacing.hpp"
#include "spn/threading/poll.hpp"
#include "spn/threading/refguard.hpp"
#include "spn/threading/semaphore.hpp"
#include "spn/threading/thread.hpp"
#include "spn/threading/work.hpp"

// timing
#include "spn/timing/elapsed_timer.hpp"
#include "spn/timing/monotonic_clock.hpp"
#include "spn/timing/periodic_timers.hpp"
#include "spn/timing/rate_control.hpp"

// note: this is a pure stub for ide's like clion which only lint/analyze files which are part of a target.

int main(void) { return 0; }
```
