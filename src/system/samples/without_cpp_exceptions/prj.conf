## CMakeLists.txt
```
cmake_minimum_required(VERSION 3.20.0)
get_filename_component(REPO_ROOT "${CMAKE_CURRENT_LIST_DIR}/../../../.." ABSOLUTE)
list(APPEND EXTRA_ZEPHYR_MODULES "${REPO_ROOT}")
find_package(Zephyr REQUIRED HINTS $ENV{ZEPHYR_BASE})

project(spn_system_without_cpp_exceptions)

target_sources(app PRIVATE src/main.cpp)
target_link_libraries(app PRIVATE
        spn::system
        spn::debugging
)
```

## sample.yaml
```
sample:
  name: system without cpp exceptions
tests:
  spn.system.sample.without_cpp_exceptions: {}
```

## prj.conf
```kconfig
# Enable fully-featured C++
CONFIG_CPP=y
CONFIG_REQUIRES_FULL_LIBCPP=y
CONFIG_STD_CPP20=y # C++20 ISO standard
CONFIG_CPP_RTTI=n
# Enable GNU-style static constructors
CONFIG_STATIC_INIT_GNU=y

# Enable SPN Libraries
CONFIG_SPN_LOGGING=y
CONFIG_SPN_SYSTEM=y
CONFIG_SPN_DEBUGGING=y
CONFIG_SPN_ASSERT_HANDLER=y

# Disable exceptions
CONFIG_CPP_EXCEPTIONS=n

# Enable logging
CONFIG_LOG=y
CONFIG_MAIN_STACK_SIZE=2048

# Enable system heap and runtime stats
CONFIG_SYS_HEAP_RUNTIME_STATS=y
CONFIG_HEAP_MEM_POOL_SIZE=8192

# Enable thread stack monitoring
CONFIG_THREAD_STACK_INFO=y
CONFIG_INIT_STACKS=y
```

## src/main.cpp
```c
#include "spn/debugging/assert.hpp"
#include "spn/logging/logging.hpp"
#include "spn/system/exception.hpp"

#include <zephyr/kernel.h>

LOG_MODULE_REGISTER(without_cpp_exceptions_sample);

class SampleShutdownManager : public spn::system::ShutdownManager {
public:
    void request_shutdown(spn::system::shutdown_reason reason) override {
        LOG_INF("shutdown requested: reason %i", static_cast<int>(reason));

        switch (reason) {
        case spn::system::shutdown_reason::exception_thrown:
            LOG_INF("shutdown due to exception (C++ exceptions disabled)");
            break;
        case spn::system::shutdown_reason::fatal_assert: LOG_INF("shutdown due to failed assertion"); break;
        default: LOG_INF("shutdown for other reason"); break;
        }

        LOG_INF("=== Sample Complete (shutting down) ===");
        spn::system::finalize_shutdown();
    }
};

int main(void) {
    LOG_INF("=== SPN System Sample (without C++ exceptions) ===");

    auto shutdown_mgr = SampleShutdownManager{};
    spn::system::set_shutdown_manager(&shutdown_mgr);

    LOG_INF("enabling exception-based assertions");
    spn::system::enable_assert_exceptions();

    LOG_INF("testing successful assertion");
    spn_assert(true);

    LOG_INF("creating runtime exception (will trigger shutdown)");
    spn::runtime_exception ex("sample runtime error");
    spn::throw_exception(ex);

    LOG_ERR("should not reach here - shutdown should have occurred");
    return 0;
}
```
