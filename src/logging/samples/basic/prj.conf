## CMakeLists.txt
```
cmake_minimum_required(VERSION 3.20.0)
get_filename_component(REPO_ROOT "${CMAKE_CURRENT_LIST_DIR}/../../../.." ABSOLUTE)
list(APPEND EXTRA_ZEPHYR_MODULES "${REPO_ROOT}")
find_package(Zephyr REQUIRED HINTS $ENV{ZEPHYR_BASE})

project(spn_logging_basic)

target_sources(app PRIVATE src/main.cpp)
target_link_libraries(app PRIVATE spn::logging)
```

## sample.yaml
```
sample:
  name: logging basic
tests:
  spn.logging.sample.basic: {}
```

## prj.conf
```kconfig
# Enable fully-featured C++
CONFIG_CPP=y
CONFIG_REQUIRES_FULL_LIBCPP=y
CONFIG_STD_CPP20=y # C++20 ISO standard
CONFIG_CPP_EXCEPTIONS=n
CONFIG_CPP_RTTI=n
# Enable GNU-style static constructors
CONFIG_STATIC_INIT_GNU=y

# Enable SPN Logging Library
CONFIG_SPN_LOGGING=y

# Enable logging
CONFIG_LOG=y
CONFIG_LOG_MODE_DEFERRED=y
CONFIG_MAIN_STACK_SIZE=2048

# Enable system heap and runtime stats
CONFIG_SYS_HEAP_RUNTIME_STATS=y
CONFIG_HEAP_MEM_POOL_SIZE=8192

# Enable thread stack monitoring (for printing stack/heap usage)
CONFIG_THREAD_STACK_INFO=y
CONFIG_INIT_STACKS=y
```

## src/main.cpp
```c
#include <spn/logging/logging.hpp>
#include <spn/logging/memory.hpp>
#include <zephyr/kernel.h>
#include <zephyr/logging/log.h>

LOG_MODULE_REGISTER(spn_logging_sample, LOG_LEVEL_INF);

int main(void) {
    LOG_INF("SPN Logging Library Sample");

    // module-based logging macros
    MLOG_INF(spn_logging_sample, "Testing MLOG_INF macro");
    MLOG_WRN(spn_logging_sample, "Testing MLOG_WRN macro");
    MLOG_ERR(spn_logging_sample, "Testing MLOG_ERR macro");

    // once-only logging macros
    for (int i = 0; i < 3; i++) {
        MLOG_WRN_ONCE(spn_logging_sample, "This warning message should only appear once (iteration %d)", i);
    }

    // memory logging utilities
    LOG_STACK_SPACE(spn_logging_sample);
    LOG_SYS_HEAP_SPACE(spn_logging_sample);

    LOG_INF("Logging sample completed");
    return 0;
}
```
