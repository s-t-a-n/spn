## CMakeLists.txt
```
cmake_minimum_required(VERSION 3.20.0)
get_filename_component(REPO_ROOT "${CMAKE_CURRENT_LIST_DIR}/../../../.." ABSOLUTE)
list(APPEND EXTRA_ZEPHYR_MODULES "${REPO_ROOT}")
find_package(Zephyr REQUIRED HINTS $ENV{ZEPHYR_BASE})

project(spn_system_shutdown_manager)

target_sources(app PRIVATE src/main.cpp)
target_link_libraries(app PRIVATE
        spn::system
        spn::debugging
)
```

## sample.yaml
```
sample:
  name: system shutdown manager
tests:
  spn.system.sample.shutdown_manager: {}
```

## prj.conf
```kconfig
# Enable fully-featured C++
CONFIG_CPP=y
CONFIG_REQUIRES_FULL_LIBCPP=y
CONFIG_STD_CPP20=y # C++20 ISO standard
CONFIG_CPP_EXCEPTIONS=n
CONFIG_CPP_RTTI=n
# Enable GNU-style static constructors
CONFIG_STATIC_INIT_GNU=y

# Enable SPN Libraries
CONFIG_SPN_LOGGING=y
CONFIG_SPN_SYSTEM=y
CONFIG_SPN_DEBUGGING=y

# Enable logging
CONFIG_LOG=y
CONFIG_LOG_MODE_DEFERRED=y
CONFIG_MAIN_STACK_SIZE=2048

# Enable system heap and runtime stats
CONFIG_SYS_HEAP_RUNTIME_STATS=y
CONFIG_HEAP_MEM_POOL_SIZE=8192
```

## src/main.cpp
```c
#include "spn/logging/logging.hpp"
#include "spn/system/exception.hpp"
#include "spn/system/shutdown.hpp"

#include <zephyr/kernel.h>

LOG_MODULE_REGISTER(shutdown_sample);

class SampleShutdownManager : public spn::system::ShutdownManager {
public:
    void request_shutdown(spn::system::shutdown_reason reason) override {
        LOG_WRN("shutdown requested: reason %i", static_cast<int>(reason));

        switch (reason) {
        case spn::system::shutdown_reason::user_request: LOG_INF("performing graceful user shutdown"); break;
        case spn::system::shutdown_reason::exception_thrown: LOG_ERR("shutdown due to exception"); break;
        case spn::system::shutdown_reason::fatal_oops: LOG_ERR("shutdown due to fatal error"); break;
        default: LOG_WRN("shutdown for unknown reason"); break;
        }

        LOG_INF("[simulated cleanup tasks]");
        k_sleep(K_MSEC(100));

        LOG_INF("finalizing shutdown");
        spn::system::finalize_shutdown();
    }
};

int main(void) {
    LOG_INF("=== SPN System Shutdown Manager Sample ===");

    auto shutdown_mgr = SampleShutdownManager{};
    spn::system::set_shutdown_manager(&shutdown_mgr);

    LOG_INF("testing user-requested shutdown");
    spn::system::request_shutdown(spn::system::shutdown_reason::user_request);

    k_sleep(K_MSEC(500));

    LOG_INF("testing exception-triggered shutdown");
    spn::runtime_exception ex("sample exception causing shutdown");
    spn::throw_exception(ex);

    LOG_ERR("should not reach here - shutdown should have occurred");

    return 0;
}
```
