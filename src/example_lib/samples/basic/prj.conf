## CMakeLists.txt
```
cmake_minimum_required(VERSION 3.20.0)
get_filename_component(REPO_ROOT "${CMAKE_CURRENT_LIST_DIR}/../../../.." ABSOLUTE)
list(APPEND EXTRA_ZEPHYR_MODULES "${REPO_ROOT}")
find_package(Zephyr REQUIRED HINTS $ENV{ZEPHYR_BASE})

project(spn_example_lib_basic)

target_sources(app PRIVATE src/main.cpp)
target_link_libraries(app PRIVATE spn::example_lib)
```

## sample.yaml
```
sample:
  name: example lib basic
tests:
  spn.example_lib.sample.basic: {}
```

## prj.conf
```kconfig
# Enable fully-featured C++
CONFIG_CPP=y
CONFIG_REQUIRES_FULL_LIBCPP=y
CONFIG_STD_CPP20=y # C++20 ISO standard
CONFIG_CPP_EXCEPTIONS=n
CONFIG_CPP_RTTI=n
# Enable GNU-style static constructors
CONFIG_STATIC_INIT_GNU=y

# Enable SPN Example Library
CONFIG_SPN_EXAMPLE_LIB=y

# Enable logging
CONFIG_LOG=y
CONFIG_LOG_MODE_DEFERRED=y
CONFIG_MAIN_STACK_SIZE=2048
```

## src/main.cpp
```c
#include "spn/example_lib/example_lib.hpp"

#include <zephyr/kernel.h>
#include <zephyr/logging/log.h>

LOG_MODULE_REGISTER(spn_example_sample, LOG_LEVEL_INF);

int main(void) {
    LOG_INF("SPN Example Library Sample");

    bool result = spn::example_lib::example_function();
    LOG_INF("example_function returned: %s", result ? "true" : "false");

    return 0;
}
```
