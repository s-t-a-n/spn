## src/Kconfig
```kconfig
rsource "core/Kconfig"
rsource "example_lib/Kconfig"
rsource "logging/Kconfig"
rsource "system/Kconfig"
rsource "debugging/Kconfig"
rsource "threading/Kconfig"
rsource "allocation/Kconfig"
rsource "containers/Kconfig"
rsource "dependency_injection/Kconfig"
rsource "timing/Kconfig"
```

## src/allocation/Kconfig
```kconfig
config SPN_ALLOCATION
    bool "Enable SPN allocation library"
    select SPN_THREADING
    select SPN_CORE
    select SPN_DEBUGGING
    select SPN_LOGGING
    select ETL
    default n
    help
      Enable the SPN allocation library
```

## src/allocation/tests/heap/testcase.yaml
```yaml
common:
  tags: spn allocation heap
  integration_platforms:
    - native_sim
tests:
  spn.allocation.heap.unit: { }
```

## src/allocation/tests/pool/testcase.yaml
```yaml
common:
  tags: spn allocation pool
  integration_platforms:
    - native_sim
tests:
  spn.allocation.pool.unit: { }
```

## src/allocation/tests/shared_ptr/testcase.yaml
```yaml
common:
  tags: spn allocation shared_ptr
  integration_platforms:
    - native_sim
tests:
  spn.allocation.shared_ptr.unit: { }
```

## src/allocation/tests/slab/testcase.yaml
```yaml
common:
  tags: spn allocation slab
  integration_platforms:
    - native_sim
tests:
  spn.allocation.slab.unit: { }
```

## src/allocation/tests/unique_ptr/testcase.yaml
```yaml
common:
  tags: spn allocation unique_ptr
  integration_platforms:
    - native_sim
tests:
  spn.allocation.unique_ptr.unit: { }
```

## src/containers/Kconfig
```kconfig
config SPN_CONTAINERS
    bool "Enable SPN containers library"
    depends on SPN_THREADING
    select SPN_CORE
    select ETL
    default n
    help
      Enable the SPN containers library
```

## src/containers/tests/callback/testcase.yaml
```yaml
common:
  tags: spn containers callback
  integration_platforms:
    - native_sim
tests:
  spn.containers.callback.unit: {}
```

## src/containers/tests/callback_delegate/testcase.yaml
```yaml
common:
  tags: spn containers callback_delegate
  integration_platforms:
    - native_sim
tests:
  spn.containers.callback_delegate.unit: {}
```

## src/containers/tests/mpmc_deque/testcase.yaml
```yaml
common:
  tags: spn containers mpmc_deque
  integration_platforms:
    - native_sim
tests:
  spn.containers.mpmc_deque.unit: {}
```

## src/containers/tests/result/testcase.yaml
```yaml
common:
  tags: spn containers result
  integration_platforms:
    - native_sim
tests:
  spn.containers.result.unit: { }
```

## src/core/Kconfig
```kconfig
config SPN_CORE
	bool "SPN Core Library"
	select ETL
	default y
	help
	  Enable the SPN core library which provides fundamental utilities
```

## src/debugging/Kconfig
```kconfig
config SPN_DEBUGGING
	bool "SPN Debugging Library"
	select LOG
	help
	  Enable the SPN debugging library

if SPN_DEBUGGING

config SPN_ASSERT_LEVEL
	int "Assertion level"
	range 0 2
	default 2
	help
	  Control the verbosity of assertions:
	  0 - Assertions disabled
	  1 - Minimal assertions (conditions only)
	  2 - Verbose assertions (with file, line, and condition info)

config SPN_ASSERT_HANDLER
	bool "Enable custom assertion handler support"
	default y
	help
	  Allow registration of custom handlers for assertions and expectations.
	  When a handler is registered, assertions will be sent to the handler
	  instead of triggering kernel panic.

endif # SPN_DEBUGGING
```

## src/debugging/tests/assert/testcase.yaml
```yaml
common:
  tags: spn debugging
  integration_platforms:
    - native_sim
tests:
  spn.debugging.assert.unit: { }
```

## src/debugging/tests/assert_with_handler/testcase.yaml
```yaml
common:
  tags: spn debugging
  integration_platforms:
    - native_sim
tests:
  spn.debugging.assert_with_handler.unit: { }
```

## src/dependency_injection/Kconfig
```kconfig
config SPN_DEPENDENCY_INJECTION
	bool "Enable SPN dependency injection library"
	select SPN_CORE
	select ETL
	default n
	help
	  Enable the SPN dependency injection library for compile-time DI.
	  This library provides a lightweight, compile-time dependency injection
	  container with support for phased initialization and automatic
	  dependency resolution.
```

## src/dependency_injection/samples/basic/sample.yaml
```yaml
sample:
  name: dependency injection basic
tests:
  spn.dependency_injection.sample.basic: {}
```

## src/dependency_injection/tests/container/testcase.yaml
```yaml
common:
  tags: spn dependency_injection
  integration_platforms:
    - native_sim
tests:
  spn.dependency_injection.container.unit: { }
```

## src/example_lib/tests/example_lib/testcase.yaml
```yaml
common:
  tags: spn example_lib
  integration_platforms:
    - native_sim
tests:
  spn.example_lib.unit: { }
```

## src/logging/Kconfig
```kconfig
config SPN_LOGGING
    bool "Enable SPN logging utilities"
    select LOG
    default y
    help
      Enable SPN logging utilities which provide convenient macros
      for Zephyr's logging system.
```

## src/system/Kconfig
```kconfig
config SPN_SYSTEM
    bool "Enable SPN system utilities"
    select SPN_LOGGING
    select SPN_DEBUGGING
    select ETL if CPP_EXCEPTIONS
    default n
    help
      Enable SPN system utilities including exception handling,
      shutdown management, and fatal error hooks for Zephyr integration.

config SPN_AUTO_EXCEPTION_ASSERTS
    bool "Automatically register exception handler for asserts"
    depends on SPN_SYSTEM && SPN_DEBUGGING && CONFIG_SPN_ASSERT_HANDLER
    default n
    help
      Automatically register the system exception handler for assertions at startup.
      When enabled, failed assertions will throw exceptions instead of halting.
```
